## meta-tinker-flutter/conf/layer.conf
```bitbake
# Tinker Board S additions on top of meta-flutter.

BBPATH .= ":${LAYERDIR}"

BBFILES += " \
    ${LAYERDIR}/recipes-*/*/*.bb \
    ${LAYERDIR}/recipes-*/*/*.bbappend \
    ${LAYERDIR}/recipes-*/*/*/*.bbappend \
"

BBFILE_COLLECTIONS += "tinker-flutter"
BBFILE_PATTERN_tinker-flutter = "^${LAYERDIR}/"
BBFILE_PRIORITY_tinker-flutter = "13"

LAYERDEPENDS_tinker-flutter = "core flutter-layer"
LAYERSERIES_COMPAT_tinker-flutter = "wrynose"
```
